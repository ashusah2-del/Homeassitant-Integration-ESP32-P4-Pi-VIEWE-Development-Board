## projects/home-assistant-p4-c6-panel/firmware/main/Kconfig.projbuild
```kconfig
menu "Home Assistant Panel Settings"

config HA_PANEL_WIFI_SSID
    string "WiFi SSID"
    default ""

config HA_PANEL_WIFI_PASSWORD
    string "WiFi Password"
    default ""

config HA_PANEL_MQTT_URI
    string "MQTT Broker URI"
    default "mqtt://homeassistant.local:1883"

config HA_PANEL_DEVICE_NAME
    string "MQTT Device Name"
    default "esp32p4_panel"

config HA_PANEL_TOPIC_PREFIX
    string "MQTT Topic Prefix"
    default "home/panel/esp32p4"

config HA_PANEL_CAMERA_STREAM_URL
    string "Camera Stream URL"
    default "http://esp32p4-panel.local:8080/stream"

endmenu
```

## projects/home-assistant-p4-c6-panel/firmware/sdkconfig.defaults
```kconfig
CONFIG_ESPTOOLPY_FLASHSIZE_16MB=y
CONFIG_PARTITION_TABLE_SINGLE_APP=y
CONFIG_PARTITION_TABLE_CUSTOM=y
CONFIG_PARTITION_TABLE_CUSTOM_FILENAME="partitions.csv"
CONFIG_HA_PANEL_WIFI_SSID=""
CONFIG_HA_PANEL_WIFI_PASSWORD=""
CONFIG_HA_PANEL_MQTT_URI="mqtt://homeassistant.local:1883"
CONFIG_HA_PANEL_DEVICE_NAME="esp32p4_panel"
CONFIG_HA_PANEL_TOPIC_PREFIX="home/panel/esp32p4"
CONFIG_HA_PANEL_CAMERA_STREAM_URL="http://esp32p4-panel.local:8080/stream"
```
